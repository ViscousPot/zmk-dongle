## config/boards/shields/enki42/Kconfig.shield
```kconfig
# Copyright (c) 2020 The ZMK Contributors
# SPDX-License-Identifier: MIT

config SHIELD_ENKI42_LEFT
	def_bool $(shields_list_contains,enki42_left)

config SHIELD_ENKI42_RIGHT
	def_bool $(shields_list_contains,enki42_right)

config SHIELD_ENKI42_DONGLE
	def_bool $(shields_list_contains,enki42_dongle)

config PROTEUS_PRESHARED_BONDS
	bool "Pre-seed BLE identity and bonds so both dongles look identical"
	depends on SHIELD_ENKI42_LEFT || SHIELD_ENKI42_RIGHT || SHIELD_ENKI42_DONGLE
	default y if SHIELD_ENKI42_LEFT || SHIELD_ENKI42_RIGHT || SHIELD_ENKI42_DONGLE
```
